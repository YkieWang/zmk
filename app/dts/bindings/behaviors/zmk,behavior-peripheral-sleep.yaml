## app/dts/bindings/behaviors/zmk,behavior-peripheral-sleep.yaml
```yaml
# Copyright (c) 2024 The ZMK Contributors
# SPDX-License-Identifier: MIT

description: Peripheral Deep Sleep Control Behavior

compatible: "zmk,behavior-peripheral-sleep"

include: one_param.yaml 
```

## app/dts/bindings/behaviors/zmk,behavior-psleep.yaml
```yaml
# Copyright (c) 2024 The ZMK Contributors
# SPDX-License-Identifier: MIT

description: ZMK Peripheral Deep Sleep Behavior

compatible: "zmk,behavior-psleep"

include: one_param.yaml 
```

## app/dts/bindings/behaviors/zmk,behavior-remote-sleep.yaml
```yaml
# Copyright (c) 2024 The ZMK Contributors
# SPDX-License-Identifier: MIT

description: Remote Sleep Control Behavior

compatible: "zmk,behavior-remote-sleep"

include: zero_param.yaml

properties:
  default-command:
    type: int
    required: false
    default: 2
    description: Default command (0=enter, 1=exit, 2=toggle)
    
  affect-peripherals:
    type: boolean
    required: false
    default: true
    description: Whether to control peripheral devices
    
  delay-ms:
    type: int
    required: false 
    default: 0
    description: Delay before executing command 
```
