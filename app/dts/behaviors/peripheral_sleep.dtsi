/*
 * Copyright (c) 2024 The ZMK Contributors
 *
 * SPDX-License-Identifier: MIT
 */

#include <dt-bindings/zmk/behaviors.h>

/ {
    behaviors {
#if ZMK_BEHAVIOR_OMIT(PERIPHERAL_SLEEP)
        /omit-if-no-ref/
#endif
        psleep: psleep {
            compatible = "zmk,behavior-peripheral-sleep";
            #binding-cells = <1>;
        };
    };
}; 